## meta-gps-clock/conf/layer.conf
```bitbake
# We have a conf and classes directory, add to BBPATH
BBPATH .= ":${LAYERDIR}"

# Recipes/appends
BBFILES += "${LAYERDIR}/recipes/*/*.bb ${LAYERDIR}/recipes/*/*.bbappend"

LAYERDIR_gps-clock := "${LAYERDIR}"

BBFILE_COLLECTIONS += "gps-clock"
BBFILE_PATTERN_gps-clock = "^${LAYERDIR}/"
BBFILE_PRIORITY_gps-clock = "6"

LAYERDEPENDS_gps-clock = ""
LAYERDEPENDS_gps-clock += "openembedded-layer"

#BBFILES += "${LAYERDIR}/recipes-beaglebone/*/*.bb ${LAYERDIR}/recipes-beaglebone/*/*.bbappend"
```

## meta-gps-clock/conf/machine/raspberrypi0-gps-clock.conf
```bitbake
#@TYPE: Machine
#@NAME: RaspberryPi Zero - GPS Clock
#@DESCRIPTION: Machine configuration for the RaspberryPi Zero within the GPS Clock setup.

include conf/machine/raspberrypi0.conf
MACHINEOVERRIDES = "raspberrypi0:raspberrypi:${MACHINE}"

SERIAL_CONSOLES = "115200;ttyAMA0 115200;ttyGS0"

IMAGE_FSTYPES = "tar.bz2 cpio.gz"

# use mainline kernel
PREFERRED_PROVIDER_virtual/kernel = "linux-mainline"

# use custom device-tree
MACHINE_ESSENTIAL_EXTRA_RDEPENDS += "device-tree"
```
